## Project Files/Conductive Heating Prototype/Firmware/sdkconfig.defaults
```kconfig
# ESP32-H2 Chip Revision Support (v1.2)
CONFIG_ESP32H2_REV_MIN_FULL=102
CONFIG_ESP32H2_REV_MIN_1_2=y
CONFIG_ESP_REV_MIN_FULL=102
```
